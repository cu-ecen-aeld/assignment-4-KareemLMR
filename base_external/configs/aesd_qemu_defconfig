## base_external/configs/aesd_qemu_defconfig
```kconfig
BR2_aarch64=y
BR2_KERNEL_HEADERS_6_8=y
BR2_TARGET_GENERIC_ROOT_PASSWD="root"
BR2_LINUX_KERNEL=y
BR2_LINUX_KERNEL_USE_ARCH_DEFAULT_CONFIG=y
BR2_LINUX_KERNEL_INSTALL_TARGET=y
BR2_PACKAGE_LIBTOMCRYPT=y
BR2_PACKAGE_OPENSSL=y
BR2_PACKAGE_CONNMAN=y
BR2_PACKAGE_CONNMAN_WIFI=y
BR2_PACKAGE_CONNMAN_LOOPBACK=y
BR2_PACKAGE_DROPBEAR=y
BR2_PACKAGE_IPROUTE2=y
BR2_PACKAGE_NETSTAT_NAT=y
BR2_PACKAGE_TCPDUMP=y
BR2_PACKAGE_TCPDUMP_SMB=y
BR2_TARGET_ROOTFS_EXT2=y
BR2_TARGET_ROOTFS_EXT2_4=y
BR2_TARGET_ROOTFS_EXT2_SIZE="4G"
BR2_PACKAGE_AESD_ASSIGNMENTS=y
```
